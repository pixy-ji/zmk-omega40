## Kconfig.defconfig
```kconfig
# Copyright (c) 2021 The ZMK Contributors
# SPDX-License-Identifier: MIT

if SHIELD_OMEGA40

config ZMK_KEYBOARD_NAME
    default "Omega40"

endif
```

## Kconfig.shield
```kconfig
# Copyright (c) 2021 The ZMK Contributors
# SPDX-License-Identifier: MIT

config SHIELD_OMEGA40
    def_bool $(shields_list_contains,omega40)
```
